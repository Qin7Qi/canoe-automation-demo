/*@!Encoding:65001*/
includes
{
  //To add the head files
}

variables
{
  msTimer msTVehSpeedDown;  // 车速下降定时器
  msTimer msTEngSpeedDown;  //发动机转速下降定时器
  dword WritePage;          //Write 窗口页面句柄
  int busflag=0;            //当前总线/IL 状态：0=IL 停止，1=IL 启动
}

//初始化
on preStart
{
  ILControlInit(); 
  ILControlStop();
  
  writeLineEx(WritePage,1,"--------This demo demonstrated the CAN bus simulation!!--------"); 
  writeLineEx(0,1,"Press <1> to start/stop CAN_logging");  
}

on key '1'
{
  int logflag;

  if(logflag==0)
  {
    logflag=1;
    write("CAN logging starts");
    //开始记录 CAN 数据，并设置 500 毫秒的预触发。
    startlogging("CAN_Logging",500);
  }
  else 
  {
    logflag=0;
    write("CAN logging ends");
    //停止记录 CAN 数据，并设置 1000 毫秒的后触发（post-trigger）。
    stoplogging("CAN_Logging",1000);
  }   
}

//根据锁车状态控制 IL
on signal_update LockStatus
{
  if(this!=busflag)
  {
    if(this==1)
    {
      ILControlStart();
    }
    else if(this==0)
    {
      ILControlStop();
    }
    busflag=this;
  }
}

//档位映射
on sysvar Vehicle_Control::Gear
{
  $Gear=@this;      
}

//初始化发动机数据
void EngineData_Init(void)
{
  $VehicleSpeed=0;
  $EngSpeed=0;
  $EngTemp=0;
  $PetrolLevel=0;
}

//钥匙状态影响发动机数据
on signal_update KeyState
{
  if(this==0)
  {
    EngineData_Init();   
  }
  if(this>0)
  {
    $PetrolLevel=255;    //油量
  }
}

//发动机转速映射
on sysvar_update Vehicle_Control::Eng_Speed     
{
  write("[Vehicle_Control::Eng_Speed] 时间=%.3f, 值=%.2f", timeNow(), this);
  write("[@Vehicle_Key::Key_State] 时间=%.3f, 值=%.2f", timeNow(), @Vehicle_Key::Key_State);
  if(@Vehicle_Key::Key_State==2)
  {
    $EngineData::EngSpeed=@this;
  }
  else
  {
    $EngineData::EngSpeed=0;
  }
}

//车速映射
on sysvar_update Vehicle_Control::Veh_Speed
{
  if((@Vehicle_Control::Gear==3)&&(@Vehicle_Key::Key_State==2))
  {
    $VehicleData::VehicleSpeed=@this;
  }
  else
  {
    $VehicleData::VehicleSpeed=0;
  }
}

//模拟加速
on sysvar_update Vehicle_Control::Speed_Up  
{
  if($EngTemp<90)
  {
    $EngTemp=@this*1.5;
  }
  else
  {
    $EngTemp=90;
  }
  if($PetrolLevel<255)
  {
    $PetrolLevel=@this*8.5;
  }
  else
  {
    $PetrolLevel=255;
  }
  @Vehicle_Control::Veh_Speed=@this;
  @Vehicle_Control::Eng_Speed=@this*40;
  if(@this>120)
  {
    @this=60;
  }
}

//刹车减速
on sysvar Vehicle_Control::Brake    
{
  int i;
  if(@this==1)
  {
    $GearLock=0;
    setTimer(msTVehSpeedDown,50);
    setTimer(msTEngSpeedDown,50);
  }
  else
  {
    $GearLock=1;
    cancelTimer(msTVehSpeedDown);
    cancelTimer(msTEngSpeedDown);
  }
}

//车速递减
on timer msTVehSpeedDown      
{
  @Vehicle_Control::Veh_Speed=@Vehicle_Control::Veh_Speed-1;
  setTimer(this,50);
  if(@Vehicle_Control::Veh_Speed<=0)
  {
    cancelTimer(msTVehSpeedDown);
    @Vehicle_Control::Veh_Speed=0;
   }
}

发动机转速递减
on timer msTEngSpeedDown    
{
  @Vehicle_Control::Eng_Speed=@Vehicle_Control::Eng_Speed-40;
  setTimer(this,50);  
  if(@Vehicle_Control::Eng_Speed<=0)
  {
    cancelTimer(msTEngSpeedDown);
    @Vehicle_Control::Eng_Speed=0;    
  }
}
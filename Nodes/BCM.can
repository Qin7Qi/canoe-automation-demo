/*@!Encoding:65001*/
includes
{
  //To add the head files
}

variables
{
  msTimer msTcrank;      // 钥匙从 Crank 回 Run 的延时
  msTimer msTIL;         // 锁车后延迟停止 IL
  int flashPeriod=500;   // 转向灯/双闪的闪烁周期，500ms

  int TurnLightStatus;   // 0=全灭，1=左转，2=右转，3=双闪
  msTimer msTleftflash,msTrightflash; // 左右转向灯闪烁定时器
  message Driver_Info Msgdriver; //驾驶信息报文
}

on preStart
{
  ILControlInit(); // 初始化交互层
  ILControlStop(); // 先停止 IL，测量启动前总线保持干净
}

//钥匙状态：Crank 模拟
on sysvar_update Vehicle_Key::Key_State
{
  $Ignition_Info::KeyState=@this;
  if(@this==3)
  {
    @Vehicle_Control::Speed_Up=0;
    setTimer(msTcrank,800);      
  }
}


on timer msTcrank
{
  $KeyState=2; 
  @sysvar::Vehicle_Key::Key_State =2;
}

on sysvar_update Vehicle_Key::Car_Driver
{
  //根据系统变量 Car_Driver 设置驾驶信息的值。
  if(@this==1)
  {
    Msgdriver.byte(0)=0;
  }
  else if(@this==2)
  {
    Msgdriver.byte(0)=0x1;
  }
  output(Msgdriver);
}

//解锁: IL 启动
on sysvar_update Vehicle_Key::Unlock_Car
{
  if(@this==1)
  {
    ILControlStart();
    $LockStatus=1;
    @Vehicle_Key::Car_Driver=2;//driver 2 is set to default
  }
}

//锁车
on sysvar_update Vehicle_Key::Lock_Car
{
  if(@this==1)
  {
    $LockStatus=0;
    setTimer(msTIL,1500); 
  }
}

//停止 IL
ON Timer msTIL
{
  ILControlStop();
}

//关闭所有灯光
void LightOFF(void)
{
  //Initilize the light status
  $VehicleLight=0;
  TurnLightStatus=0;
  $LightStatus=0;  
}

////////////////////实现左转、右转及危险报警闪光灯功能///////////////
//左转
on sysvar Vehicle_Control::Left_Turn_Enable
{
  if(@this==1)
  {
    @sysvar::Vehicle_Control::Right_Turn_Enable=0;
    $VehicleLight=1;TurnLightStatus=1;
    settimer(msTleftflash,flashPeriod);
  }
  else
  {
    if(@Vehicle_Control::Right_Turn_Enable==0 && @Vehicle_Control::Hazards_Enable==0)
    {
      LightOFF();
    }
    cancelTimer(msTleftflash);
    @Cluster::Left_Turn_Indicator=0;
  }
}

on timer msTleftflash
{
  $LightStatus=!$LightStatus;@Cluster::Left_Turn_Indicator=!@Cluster::Left_Turn_Indicator;
  setTimer(msTleftflash,flashPeriod);
}

//右转
on sysvar Vehicle_Control::Right_Turn_Enable
{
  if(@this==1)
  {
    @sysvar::Vehicle_Control::Left_Turn_Enable=0;
    $VehicleLight=2;TurnLightStatus=2;
    settimer(msTrightflash,flashPeriod);
  }
  else
  {
    if(@Vehicle_Control::Left_Turn_Enable==0 && @Vehicle_Control::Hazards_Enable==0)
    {
      LightOFF();
    }
    cancelTimer(msTrightflash);
    @Cluster::Right_Turn_Indicator=0;
  }
}

on timer msTrightflash
{
  $LightStatus=!$LightStatus;@Cluster::Right_Turn_Indicator=!@Cluster::Right_Turn_Indicator;
  setTimer(msTrightflash,flashPeriod);
}

//双闪
on sysvar Vehicle_Control::Hazards_Enable
{
  if(@this==1)
  {
    $VehicleLight=3;@Cluster::Left_Turn_Indicator=1;@Cluster::Right_Turn_Indicator=1;
    settimer(msTleftflash,flashPeriod);setTimer(msTrightflash,flashPeriod);
  }
  else
  {
    $VehicleLight=TurnLightStatus;
    switch(TurnLightStatus)
    {
      case 1: //Left Light flash
        cancelTimer(msTrightflash);
        @Cluster::Right_Turn_Indicator=0;
      break;
      case 2: //Right Light flash
        cancelTimer(msTleftflash);
        @Cluster::Left_Turn_Indicator=0;
      break;
      case 0: //swicth off both light
        cancelTimer(msTrightflash);
        cancelTimer(msTleftflash);
        $LightStatus=0;
        @Cluster::Left_Turn_Indicator=0;
        @Cluster::Right_Turn_Indicator=0;
      break;
    }
  }
}

on signal EngineData::EngSpeed
{
  write("[EngineData::EngSpeed] 时间=%.3f, 值=%.2f", timeNow(), this);
}
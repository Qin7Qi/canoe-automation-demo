/*@!Encoding:65001*/
includes
{
}

variables
{
  //会话状态：默认会话、扩展会话、生产会话。
  enum ESession {DefaultSession, ExtendedSession, ProductionSession}; 
  //安全等级：锁定、1级解锁、2级解锁。
  enum ESecurityLevel {Lock, Unlock_1, Unlock_2};
  int CURRENT_SESSION;
  int CURRENT_SECURITY_LEVEL;
  //P2/P2Ex 时间参数
  byte SESSION_TIMING_P2[2] = {0x00, 0x96};
  byte SESSION_TIMING_PX[2] = {0x00, 0xC8};

  byte MANUFACTURING_DATE[3] = {18, 10, 18};
  //序列号和 VIN
  byte SERIAL_NUMBER[9] = {0x31, 0x32, 0x33, 0x34, 0x35, 0x36, 0x37, 0x38, 0x39};
  byte VEHICLE_IDENTIFICATION_NUMBER[17] = {0x61, 0x62, 0x63, 0x64, 0x65, 0x66, 0x67, 0x68, 0x31, 0x32, 0x33, 0x34, 0x35, 0x36, 0x37, 0x38, 0x39};
  //发动机转速、发动机温度
  byte Speedbuffer[2],EngTempbuffer[1];
  //安全访问用：种子、ECU钥匙、诊断仪钥匙。
  byte SECURITY_SEED[4];
  byte SECURITY_KEY[4]; 
  byte SECURITY_KEY_RECEIVED[4];

  double countrycode=0,vehicletype=3,beltwarning=0,overspeedwarning=0;
  //前 IL 状态：0=停发，1=发
  int busflag=0;  

}


///////////////////////////////////////////////////////Function/////////////////////////////////////////////////////////
//初始化 CANoe IL
on preStart
{
  ILControlInit(); 
  ILControlStop();  
}

//诊断会话置为默认会话
on start
{
  CURRENT_SESSION=DefaultSession;
}

on signal_update LockStatus
{
  if(this!=busflag)
  {
    if(this==1)
    {
      ILControlStart();  //Activate CANoe IL    
    }
    else if(this==0)
    {
      ILControlStop();  //Deactivate CANoe IL      
    }
    busflag=this;
  }
}

//IPC 面板显示当前档位
on signal_update Gear
{
  @Cluster::Gear_Status= this;   //To display current Gear status in panel
}
///////////////////////////////////////////////////////Function/////////////////////////////////////////////////////////

//////////////////////////////////////////////////////Diagnosis/////////////////////////////////////////////////////////

//////////////////////////////////////////////////////Session///////////////////////////////////////////////////////////

//会话控制
//处理切换到默认会话的请求
on diagRequest IPC.DefaultSession_Start
{
  //设置默认会话请求的参数与响应
  diagResponse this resp;
  resp.SetParameterRaw("P2",SESSION_TIMING_P2,elCount(SESSION_TIMING_P2));
  resp.SetParameterRaw("P2Ex",SESSION_TIMING_PX,elCount(SESSION_TIMING_PX));
  CURRENT_SESSION=DefaultSession;
  CURRENT_SECURITY_LEVEL=Lock;
  @Diagnosis::Security_Level=0;
  @Diagnosis::Session=0;
  resp.SendPositiveResponse(); 
}

//处理切换到扩展会话的请求
on diagRequest IPC.ExtendedDiagnosticSession_Start
{
  //设置扩展会话请求的参数及响应
  diagResponse this resp;
  resp.SetParameterRaw("P2",SESSION_TIMING_P2,elCount(SESSION_TIMING_P2));
  resp.SetParameterRaw("P2Ex",SESSION_TIMING_PX,elCount(SESSION_TIMING_PX));
  CURRENT_SESSION=ExtendedSession;
  @Diagnosis::Session=1;
  resp.SendPositiveResponse(); 
}

//处理切换到生产会话的请求
on diagRequest IPC.Production_Session_Start
{
  //为生产环境会话请求设置参数及响应
  diagResponse this resp;
  //判断肯定请求条件
  if(CURRENT_SESSION==ExtendedSession)
  {
    resp.SetParameterRaw("P2",SESSION_TIMING_P2,elCount(SESSION_TIMING_P2));
    resp.SetParameterRaw("P2Ex",SESSION_TIMING_PX,elCount(SESSION_TIMING_PX));
    CURRENT_SESSION=ProductionSession;
    @Diagnosis::Session=2;
    @Diagnosis::Security_Level=0;
    CURRENT_SECURITY_LEVEL=Lock;
    resp.SendPositiveResponse();    
  }
  else
    resp.SendNegativeResponse(0x7E);  

}
//////////////////////////////////////////////////////Session///////////////////////////////////////////////////////////

/////////////////////////////////////////Manufacture Date Read/Write////////////////////////////////////

//读取制造日期
on diagRequest IPC.ECU_Manufacturing_Date_Read
{
  //设置 ECU_Manufacturing_Date_Read 请求的参数及响应
  diagResponse this resp;
  //判断肯定请求条件
  if(@Diagnosis::Manufacture_Date_NRC==1)
  {
    resp.SendNegativeResponse(0x22);
  }
  else
  {
    resp.SetParameter("Manufacturing_date_Year",MANUFACTURING_DATE[0]);
    resp.SetParameter("Manufacturing_date_Month",MANUFACTURING_DATE[1]);
    resp.SetParameter("Manufacturing_date_Day",MANUFACTURING_DATE[2]);
    resp.SendPositiveResponse();
  }
}

//写制造日期
on diagRequest IPC.ECU_Manufacturing_Date_Write
{
  //针对 ECU_Manufacturing_Date_Write 请求，判定其正向请求条件。
  diagResponse this resp;
  if(CURRENT_SECURITY_LEVEL==Unlock_1)
  {
    //模拟“写权限通过”，不真正更新数组
     resp.SendPositiveResponse(); 
  }
  else
    resp.SendNegativeResponse(0x33);
}
/////////////////////////////////////////Manufacture Date Read/Write////////////////////////////////////

////////////////////////////////////////Serial Number Read/Write///////////////////////////////////////

//读取序列号
on diagRequest IPC.ECU_Serial_Number_Read
{
  //为 ECU_Serial_Number_Read 请求设置参数及响应
  diagResponse this resp;
  if(@Diagnosis::Serial_Number_NRC)
  {
    resp.SendNegativeResponse(0x22);
  }
  else
  {
    resp.SetParameterRaw("Serial_Number",SERIAL_NUMBER,elCount(SERIAL_NUMBER));
    resp.SendPositiveResponse(); 
  }   

}

//写序列号
on diagRequest IPC.ECU_Serial_Number_Write
{
  diagResponse this resp;
  if(CURRENT_SECURITY_LEVEL==Unlock_1)
  {
    this.GetParameterRaw("Serial_Number",SERIAL_NUMBER,elCount(SERIAL_NUMBER));
    resp.sendPositiveResponse();    
  }
  else
    resp.SendNegativeResponse(0x33);
}
////////////////////////////////////////Serial Number Read/Write///////////////////////////////////////

///////////////////////////////////ECU Identification Number Read/Write////////////////////////////////

//读取 VIN
on diagRequest IPC.Vehicle_Identification_Number_Read
{
  //为“读取车辆识别码 (Vehicle_Identification_Number_Read)”请求设置参数及响应
  diagResponse this resp;
  long ret;
  write("Vehicle_Identification_Number_Read");
  if(CURRENT_SECURITY_LEVEL==Unlock_1)
  {
    write("Unlock_1");
    if(@Diagnosis::Identification_Number_NRC)
    {
      write("Identification_Number_NRC");      
      resp.SendNegativeResponse(0x22);
    }
    else
    {
      ret = resp.SetParameterRaw("VIN",VEHICLE_IDENTIFICATION_NUMBER,elCount(VEHICLE_IDENTIFICATION_NUMBER));
      write("[IPC] SetParameterRaw 返回 %d", ret);
      
      resp.SendPositiveResponse();   
    }
  }
  else
    resp.SendNegativeResponse(0x33);
}

//写 VIN
on diagRequest IPC.Vehicle_Identification_Number_Write
{
  diagResponse this resp;
  if(CURRENT_SECURITY_LEVEL==Unlock_2)
  {
    this.GetParameterRaw("VIN",VEHICLE_IDENTIFICATION_NUMBER,elCount(VEHICLE_IDENTIFICATION_NUMBER));
    resp.sendPositiveResponse();
  }
  else
    resp.SendNegativeResponse(0x33);
}
///////////////////////////////////ECU Identification Number Read/Write////////////////////////////////

//////////////////////////////////////Variant Coding Read/Write////////////////////////////////////////

//读取变体编码
on diagRequest IPC.Variant_Coding_Read
{
  //为 Variant_Coding_Read 请求设置参数及响应
  diagResponse this resp;
  if(@Diagnosis::Variant_Coding_NRC)
  {
    resp.SendNegativeResponse(0x22); 
  }
  else
  {
    resp.SetParameter("Coding_String.Country_Code",countrycode);
    resp.SetParameter("Coding_String.Vehicle_Type",vehicletype);
    resp.SetParameter("Coding_String.Belt_Warning",beltwarning);
    resp.SetParameter("Coding_String.OverSpeed_Warning",overspeedwarning);
    resp.sendPositiveResponse(); 
  }
}

//写变体编码
on diagRequest IPC.Variant_Coding_Write
{
  diagResponse this resp;
  if(CURRENT_SECURITY_LEVEL==Unlock_1)
  {
    countrycode=this.GetParameter("Coding_String.Country_Code");
    vehicletype=this.GetParameter("Coding_String.Vehicle_Type");
    beltwarning=this.GetParameter("Coding_String.Belt_Warning");
    overspeedwarning=this.GetParameter("Coding_String.OverSpeed_Warning");
    resp.sendPositiveResponse();    
  }
  else
    resp.SendNegativeResponse(0x33);

}
//////////////////////////////////////Variant Coding Read/Write////////////////////////////////////////

//////////////////////////////////////////////////DID//////////////////////////////////////////////////

//每收到一帧 EngineData 报文，就缓存 DID 读取要用的原始数据
on message EngineData
{
  EngTempbuffer[0]=this.byte(0)*2;
  Speedbuffer[1]=this.byte(2);
  Speedbuffer[0]=this.byte(3);
}

//读取发动机转速 DID
on diagRequest IPC.DID_Engine_Speed_Read
{
  //为 DID_Engine_Speed_Read 请求设置参数及响应
  diagResponse this resp;
  resp.SetParameterRaw("DID_Engine_Speed",Speedbuffer,elcount(Speedbuffer));
  resp.SendPositiveResponse();
}

//读取发动机温度 DID
on diagRequest IPC.DID_Engine_Temperature_Read
{
  diagResponse this resp;
  resp.SetParameterRaw("DID_Engine_Temperature",EngTempbuffer,elcount(EngTempbuffer));
  resp.SendPositiveResponse();  
}

//读取电源电压 DID
on diagRequest IPC.Power_Supply_Voltage_Read
{
  //Set parameter and response for Power_Supply_Voltage_Read request
  diagResponse this resp;
  resp.SetParameter("DataRecord",@Diagnosis::Power_Supply_Voltage);
  resp.SendPositiveResponse();  
}
//////////////////////////////////////////////////DID//////////////////////////////////////////////////

/////////////////////////////////////////////Active Session////////////////////////////////////////////

//返回当前诊断会话类型
on diagRequest IPC.Active_Diagnostic_Session_Read
{
  diagResponse this resp;
  switch (CURRENT_SESSION)
  {
    case DefaultSession:
    {
      resp.SetParameter("Diagnostic_Session_Type",0x01);
      break;
    }
    case ExtendedSession:
    {
      resp.SetParameter("Diagnostic_Session_Type",0x03);
      break;
    }
    case ProductionSession:
    {
      resp.SetParameter("Diagnostic_Session_Type",0x02);
      break;
    }
  }
  resp.SendPositiveResponse();
}
/////////////////////////////////////////////Active Session////////////////////////////////////////////

//////////////////////////////////////////////Security/////////////////////////////////////////////////
//请求 1 级安全访问种子
on diagRequest IPC.SeedLevel1_Request
{
  diagResponse this resp;
  if(CURRENT_SESSION==ExtendedSession)
  {
    
    Seed_Generation();
    KeyLevel1_Calculate();
    resp.SetParameterRaw("SecuritySeed",SECURITY_SEED,elcount(SECURITY_SEED));
    resp.SendPositiveResponse();     
  }
  else 
    resp.SendNegativeResponse(0x7E);
}

//校验诊断仪发来的 1 级钥匙
on diagRequest IPC.KeyLevel1_Send
{
  diagResponse this resp;
  this.GetParameterRaw("SecurityKey",SECURITY_KEY_RECEIVED,elCount(SECURITY_KEY_RECEIVED));
  if(KEY_VERIFY()==1)
  {
    resp.SendPositiveResponse();
    CURRENT_SECURITY_LEVEL=Unlock_1;
    @Diagnosis::Security_Level=1;
  }
  else
    resp.SendNegativeResponse(0x35);
}

//请求 2 级安全访问种子
on diagRequest IPC.Seed_Level_2_Request
{
  diagResponse this resp;
  if(CURRENT_SECURITY_LEVEL==Unlock_1)
  {
    Seed_Generation();
    KeyLevel2_Calculate();
    resp.SetParameterRaw("SecuritySeed",SECURITY_SEED,elcount(SECURITY_SEED));
    resp.SendPositiveResponse();     
  }
  else
    resp.SendNegativeResponse(0x33);//Security access denied

}

//校验 2 级钥匙
on diagRequest IPC.Key_Level_2_Send
{
  diagResponse this resp;
  this.GetParameterRaw("SecurityKey",SECURITY_KEY_RECEIVED,elCount(SECURITY_KEY_RECEIVED));
  if(KEY_VERIFY()==1)
  {
    resp.SendPositiveResponse();
    CURRENT_SECURITY_LEVEL=Unlock_2;
    @Diagnosis::Security_Level=2;
  }
  else
    resp.SendNegativeResponse(0x35);  
}

//生成 4 字节安全种子
void Seed_Generation()
{
  //Generate seed
  int i;
  byte temp;
  for(i = 0; i < 4; i++)
  {
    temp = (int)random(250);
    SECURITY_SEED[i] = temp;
    SECURITY_KEY[i] = temp;
  }
}

void KeyLevel1_Calculate()
{
  //Calculate the key for security leve1 1
  byte temp;
  temp = SECURITY_KEY[0];
  SECURITY_KEY[0] = SECURITY_KEY[1];
  SECURITY_KEY[1] = temp;
}

void KeyLevel2_Calculate()
{
  //Calculate the key for security leve1 1
  byte temp;
  temp = SECURITY_KEY[1];
  SECURITY_KEY[1] = SECURITY_KEY[2];
  SECURITY_KEY[2] = temp;
}

//比较 SECURITY_KEY 和 SECURITY_KEY_RECEIVED 的 4 个字节
int KEY_VERIFY()
{
  //Verify the security key;
  int i;
  for (i = 0; i < 4; i++)
  {
    if(SECURITY_KEY[i] != SECURITY_KEY_RECEIVED[i])
      return -1;
  }
  return 1;
}
//////////////////////////////////////////////Security/////////////////////////////////////////////////

/////////////////////////////////////////////Conmmunication Control////////////////////////////////////

//诊断仪请求“使能接收、禁止发送”
on diagRequest IPC.EnableRxAndDisableTx_Control
{
  //Send negative response for EnableRxAndDisableTx_Control request
  diagResponse this resp;
  resp.SendNegativeResponse(0x12);  
}

//诊断仪请求“使能接收、使能发送”
on diagRequest IPC.EnableRxAndEnableTx_Control
{
  //Send negative response for EnableRxAndEnableTx_Control request
  diagResponse this resp;
  resp.SendNegativeResponse(0x12);  
}
/////////////////////////////////////////////Conmmunication Control////////////////////////////////////

//////////////////////////////////////////////////Hard Reset///////////////////////////////////////////
诊断仪请求硬复位
on diagRequest IPC.HardReset_Reset
{
  //Send negative response for HardReset_Reset request
  diagResponse this resp;
  resp.SendNegativeResponse(0x12);  
}

//////////////////////////////////////////////////Hard Reset///////////////////////////////////////////

//////////////////////////////////////////////////////Diagnosis/////////////////////////////////////////////////////////